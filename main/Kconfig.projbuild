## main/Kconfig.projbuild
```kconfig
menu "ESP32 Uart Bridge Configuration"

    orsource "$IDF_PATH/examples/common_components/env_caps/$IDF_TARGET/Kconfig.env_caps"

    config UBRIDGE_UART_PORT_NUM
        int "UART port number"
        range 0 2 if IDF_TARGET_ESP32 || IDF_TARGET_ESP32S3
        default 2 if IDF_TARGET_ESP32 || IDF_TARGET_ESP32S3
        range 0 1 if IDF_TARGET_ESP32S2 || IDF_TARGET_ESP32C3 || IDF_TARGET_ESP32C2 || IDF_TARGET_ESP32H2
        default 1 if IDF_TARGET_ESP32S2 || IDF_TARGET_ESP32C3 || IDF_TARGET_ESP32C2 || IDF_TARGET_ESP32H2
        help
            UART communication port number.
            See UART documentation for available port numbers.

    config UBRIDGE_UART_BAUD_RATE
        int "UART communication speed"
        range 1200 115200
        default 115200
        help
            UART communication speed.

    choice UBRIDGE_UART_PARITY
        prompt "UART parity"
        default UBRIDGE_UART_PARITY_NONE
        help
            This option sets parity settings for the current UART configuration.

            - The "None" parity disabled.
            - The "Even" parity even.
            - The "Odd" parity odd.

        config UBRIDGE_UART_PARITY_NONE
            bool "None"
        config UBRIDGE_UART_PARITY_EVEN
            bool "Even"
        config UBRIDGE_UART_PARITY_ODD
            bool "Odd"

    endchoice

    config UBRIDGE_UART_PARITY
        int
        default 0 if UBRIDGE_UART_PARITY_NONE
        default 2 if UBRIDGE_UART_PARITY_EVEN
        default 3 if UBRIDGE_UART_PARITY_ODD

    config UBRIDGE_UART_RXD
        int "UART RXD pin number"
        range ENV_GPIO_RANGE_MIN 25
        default 5
        help
            GPIO number for UART RX pin. See UART documentation for more information
            about available pin numbers for UART.

    config UBRIDGE_UART_TXD
        int "UART TXD pin number"
        range ENV_GPIO_RANGE_MIN 25
        default 4
        help
            GPIO number for UART TX pin. See UART documentation for more information
            about available pin numbers for UART.

    config UBRIDGE_TASK_STACK_SIZE
        int "Bridge task stack size"
        range 1024 16384
        default 2048
        help
            Defines stack size for UART bridge. Insufficient stack size can cause crash.

endmenu
```
